## conf/layer.conf
```bitbake
# We have a conf and classes directory, add to BBPATH
BBPATH .= ":${LAYERDIR}"

BBFILE_COLLECTIONS += "yocto-rock64"
BBFILE_PATTERN_yocto-rock64 = "^${LAYERDIR}/"
BBFILE_PRIORITY_yocto-rock64 = "6"

LAYERDEPENDS_yocto-rock64 = "core"
LAYERSERIES_COMPAT_yocto-rock64 = "dunfell hardknott"
```

## layers/meta-backup-gadget/conf/distro/backup-gadget.conf
```bitbake
DISTRO = "backup-gadget"
DISTRO_NAME = "Backup Gadget"
DISTRO_VERSION = "1"

DISTRO_FEATURES = " \
    acl alsa debuginfod ext2 ipv4 ipv6 pcmcia usbhost xattr nfs \
    zeroconf pci vfat seccomp gobject-introspection-data ldconfig \
"

PREFERRED_RPROVIDER_ssh = "openssh"

PACKAGECONFIG:remove:pn-systemd = "sysvinit"

include conf/distro/gadget-distro.conf
```

## layers/meta-dns-gadget/conf/layer.conf
```bitbake
# We have a conf and classes directory, add to BBPATH
BBPATH .= ":${LAYERDIR}"

# We have recipes-* directories, add to BBFILES
BBFILES += "${LAYERDIR}/recipes-*/*/*.bb \
            ${LAYERDIR}/recipes-*/*/*.bbappend"

BBFILE_COLLECTIONS += "dns-gadget"
BBFILE_PATTERN_dns-gadget = "^${LAYERDIR}/"
BBFILE_PRIORITY_dns-gadget = "24"

LAYERDEPENDS_dns-gadget = "core gadget"
LAYERSERIES_COMPAT_dns-gadget = "styhead walnascar"
```

## layers/meta-email-gadget/conf/distro/email-gadget.conf
```bitbake
DISTRO = "email-gadget"
DISTRO_NAME = "Email Gadget"
DISTRO_VERSION = "1"

DISTRO_FEATURES = "sasl ipv4 ipv6"
DISTRO_FEATURES_BACKFILL_CONSIDERED = "pulseaudio gobject-introspection-data"

PACKAGECONFIG:remove:pn-systemd = "resolved nss-resolve"

require conf/distro/gadget-distro.conf
```

## layers/meta-gadget/conf/distro/gadget-distro.conf
```bitbake
INIT_MANAGER = "systemd"
VIRTUAL-RUNTIME_initscripts = ""

DISTRO_FEATURES:append:ab-mutable = " rauc"
PREFERRED_RPROVIDER_virtual-grub-bootconf = "rauc-grub-bootconf"
```

## layers/meta-gadget/conf/machine/ab-mutable.conf
```bitbake
MACHINEOVERRIDES =. "ab-mutable:"

INITRAMFS_IMAGE = "rauc-initramfs-image"
INITRAMFS_IMAGE_BUNDLE = "1"

# Install kernel image and device tree into the rootfs (instead of the boot
# partition)
RDEPENDS:${KERNEL_PACKAGE_NAME}-base += "kernel-image"

# The order of these matters. RAUC uses the first one as the image type to
# place in the bundle.
IMAGE_FSTYPES = "ext4"

# Needed so that the rauc-label-handler can identify the bundle
EXTRA_IMAGECMD:ext4 = "-L rootfs-bundle"

# Add stuff needed for software update (using RAUC)
MACHINE_ESSENTIAL_EXTRA_RRECOMMENDS:append = " \
    rauc \
    e2fsprogs \
    e2fsprogs-dumpe2fs \
    e2fsprogs-tune2fs \
    rauc-label-handler \
    kernel-module-dm-verity \
    kernel-module-nbd \
    kernel-module-squashfs \
"

# Add stuff needed for gadget rw data partition
MACHINE_ESSENTIAL_EXTRA_RRECOMMENDS:append = " \
    btrfs-tools \
    kernel-module-btrfs \
    kernel-module-overlay \
"

# Don't make /var/log a symlink to /var/volatile/log
FILESYSTEM_PERMS_TABLES:remove = "files/fs-perms-volatile-log.txt"
```

## layers/meta-gadget/wic/ab-mutable-raspberrypi.wks
```
# short-description: Raspberry Pi Dual A/B image w/ mutable data partition

part /boot --source bootimg-partition --fstype=vfat --ondisk mmcblk0 --label boot --active --align 4096 --size 100
part / --source rootfs --fstype=ext4 --ondisk mmcblk0 --label system0 --align 4096 --size 4G
part --ondisk mmcblk0 --label system1 --align 4096 --size 4G
part --ondisk mmcblk0 --fstype=btrfs --label gadget-data --align 1024 --size 8G
```

## layers/meta-gadget/wic/x86-64-mutable-gadget.wks
```
# short-description: x86-64 Dual A/B image w/ mutable data partition

part /boot --source bootimg-efi --sourceparams="loader=grub-efi" --fstype=vfat --label boot --active --align 1024
part / --source rootfs --fstype=ext4 --label system0 --align 4096 --size 4G
part --label system1 --align 4096 --size 4G
part --ondisk mmcblk0 --fstype=btrfs --label gadget-data --align 1024 --size 8G
bootloader --ptable=gpt --configfile="x86-64-mutable-gadget-grub.cfg"
```

## meta-backup-gadget/conf/distro/backup-gadget.conf
```bitbake
DISTRO = "backup-gadget"
DISTRO_NAME = "Backup Gadget"
DISTRO_VERSION = "1"

DISTRO_FEATURES = " \
    acl alsa debuginfod ext2 ipv4 ipv6 pcmcia usbhost xattr nfs \
    zeroconf pci vfat seccomp sysvinit gobject-introspection-data \
    ldconfig \
"

PACKAGECONFIG:append:busybox = " ntpd"

include conf/distro/gadget-distro.conf
```

## meta-backup-gadget/conf/layer.conf
```bitbake
# We have a conf and classes directory, add to BBPATH
BBPATH .= ":${LAYERDIR}"

# We have recipes-* directories, add to BBFILES
BBFILES += "${LAYERDIR}/recipes-*/*/*.bb \
            ${LAYERDIR}/recipes-*/*/*.bbappend"

BBFILE_COLLECTIONS += "meta-backup-gadget"
BBFILE_PATTERN_meta-backup-gadget = "^${LAYERDIR}/"
BBFILE_PRIORITY_meta-backup-gadget = "6"

LAYERDEPENDS_meta-backup-gadget = "core"
LAYERSERIES_COMPAT_meta-backup-gadget = "walnascar whinlatter"
```

## meta-backup-gadget/conf/machine/backup-gadget-v1.conf
```bitbake
require conf/machine/x86-64-mutable-gadget.conf

KMACHINE:backup-gadget-v1 = "common-pc-64"
RAUC_CONFIG_FILE = "${@bb.utils.which(d.getVar('BBPATH'), 'files/rauc-backup-gadget-v1.conf')}"

# Driver for the Nuvoton NCT6792D Super IO chip. The hddfancontrol service is
# configured to monitor and regulate HDD temperature reported through S.M.A.R.T
# by driving a known fan PWM on this chip.
MACHINE_EXTRA_RRECOMMENDS += " \
    kernel-module-nct6775 \
    kernel-module-nct6775-core \
    hddfancontrol \
"

KERNEL_MODULE_AUTOLOAD += "nct6775"

# Drivers/firmware/services for Wi-Fi using the Intel Wi-Fi radio. Cryptography
# modules are requirements of IWD
MACHINE_EXTRA_RRECOMMENDS += " \
    kernel-module-iwlwifi \
    kernel-module-iwlmvm \
    wireless-regdb-static \
    linux-firmware-iwlwifi \
    iwd \
    kernel-module-algif-hash \
    kernel-module-algif-skcipher \
    kernel-module-des-generic \
    kernel-module-sha1 \
    kernel-module-aesni-intel \
    kernel-module-des3-ede-x86-64 \
"

# Driver/firmware for the Realtek Gigabit LAN
MACHINE_EXTRA_RRECOMMENDS += " \
    kernel-module-r8169 \
    kernel-module-realtek \
    linux-firmware-rtl8168 \
"

# CPU Temperature Sensor Driver
IMAGE_INSTALL += "kernel-module-k10temp"

# Try to detect bad RAM on boot (don't want data to be corrupted in transit to
# the disk)
APPEND += "memtest=1"
```

## meta-edtwardy/conf/layer.conf
```bitbake
# We have a conf and classes directory, add to BBPATH
BBPATH .= ":${LAYERDIR}"

# We have recipes-* directories, add to BBFILES
BBFILES += "${LAYERDIR}/recipes-*/*/*.bb \
            ${LAYERDIR}/recipes-*/*/*.bbappend"

BBFILE_COLLECTIONS += "edtwardy"
BBFILE_PATTERN_edtwardy = "^${LAYERDIR}/"
BBFILE_PRIORITY_edtwardy = "6"

LAYERDEPENDS_edtwardy = "core"
LAYERSERIES_COMPAT_edtwardy = "honister"
```

## meta-edtwardy/conf/machine/qemu-x86_64.conf
```bitbake
DEFAULTTUNE ?= "core2-64"
MACHINE_FEATURES += "x86 pci"
require conf/machine/include/x86/tune-core2.inc
require conf/machine/include/x86/qemuboot-x86.inc

# Don't include kernels in standard images
RDEPENDS:${KERNEL_PACKAGE_NAME}-base = ""

MACHINEOVERRIDES =. "qemuall:"

IMAGE_FSTYPES += "wic cpio.gz"
WKS_FILE = "qemu-debug-minimal.wks"

SERIAL_CONSOLES = "115200;ttyS0"
```

## meta-edtwardy/wic/qemu-debug-minimal.wks
```
part /boot --fstype=vfat --label boot --active --align 1024 --use-uuid --fixed-size 128M
part / --source rootfs --fstype=ext4 --label root --align 1024 --use-uuid
```

## meta-email-gadget/conf/distro/email-gadget.conf
```bitbake
DISTRO = "email-gadget"
DISTRO_NAME = "email-gadget"
DISTRO_VERSION = "1"

# x11 is required for gnuplot
DISTRO_FEATURES = "x11 sasl ipv4 ipv6"
DISTRO_FEATURES_BACKFILL_CONSIDERED = "pulseaudio gobject-introspection-data"

require conf/distro/gadget-distro.conf
```

## meta-email-gadget/conf/layer.conf
```bitbake
# We have a conf and classes directory, add to BBPATH
BBPATH .= ":${LAYERDIR}"

# We have recipes-* directories, add to BBFILES
BBFILES += "${LAYERDIR}/recipes-*/*/*.bb \
            ${LAYERDIR}/recipes-*/*/*.bbappend"

BBFILES_DYNAMIC += " \
    raspberrypi:${LAYERDIR}/dynamic-layers/raspberrypi/recipes-*/*/*.bb \
    raspberrypi:${LAYERDIR}/dynamic-layers/raspberrypi/recipes-*/*/*.bbappend \
"

BBFILE_COLLECTIONS += "email-gadget"
BBFILE_PATTERN_email-gadget = "^${LAYERDIR}/"
BBFILE_PRIORITY_email-gadget = "24"

LAYERDEPENDS_email-gadget = "core gadget"
LAYERSERIES_COMPAT_email-gadget = "scarthgap styhead"
```

## meta-gadget/conf/layer.conf
```bitbake
# We have a conf and classes directory, add to BBPATH
BBPATH .= ":${LAYERDIR}"

# We have recipes-* directories, add to BBFILES
BBFILES += "${LAYERDIR}/recipes-*/*/*.bb \
            ${LAYERDIR}/recipes-*/*/*.bbappend"

BBFILES_DYNAMIC += " \
    raspberrypi:${LAYERDIR}/dynamic-layers/raspberrypi/recipes-*/*/*.bb \
    raspberrypi:${LAYERDIR}/dynamic-layers/raspberrypi/recipes-*/*/*.bbappend \
"

BBFILE_COLLECTIONS += "gadget"
BBFILE_PATTERN_gadget = "^${LAYERDIR}/"
BBFILE_PRIORITY_gadget = "16"

LAYERDEPENDS_gadget = "core rauc"
LAYERSERIES_COMPAT_gadget = "scarthgap styhead"
```

## meta-gadget/conf/machine/ab-mutable.conf
```bitbake
MACHINEOVERRIDES =. "ab-mutable:"

OVERLAYFS_ETC_MOUNT_POINT = "/data/etc"
OVERLAYFS_ETC_DEVICE = "LABEL=gadget-data"
OVERLAYFS_ETC_FSTYPE = "btrfs"
OVERLAYFS_ETC_MOUNT_OPTIONS = "discard=async,space_cache=v2,subvol=/@etc"
OVERLAYFS_ETC_USE_ORIG_INIT_NAME = "0"
OVERLAYFS_ETC_CREATE_MOUNT_DIRS = "0"

# Install kernel image and device tree into the rootfs (instead of the boot
# partition)
RDEPENDS:${KERNEL_PACKAGE_NAME}-base += "kernel-image"

# Add stuff needed for software update (using RAUC)
MACHINE_ESSENTIAL_EXTRA_RRECOMMENDS:append = " \
    rauc \
    e2fsprogs \
    kernel-module-dm-verity \
    kernel-module-nbd \
    kernel-module-squashfs \
"

# Add stuff needed for gadget rw data partition
MACHINE_ESSENTIAL_EXTRA_RRECOMMENDS:append = " \
    btrfs-tools \
    kernel-module-btrfs \
    kernel-module-overlay \
"
```

## meta-gadget/conf/machine/cloud-mutable-gadget.conf
```bitbake
require conf/machine/qemux86-64.conf
require conf/machine/ab-mutable.conf

SUMMARY = "Linode cloud instance gadget"
DESCRIPTION = "This a/b mutable gadget is compatible with Linode cloud \
instances. It boots using a GRUB2 configuration, and each rootfs partition is \
a separate disk. Contrary to popular wisdom, a 'disk' in Linode is a \
container for a raw partition image, not a disk image (no partition table). \
In addition to the gadget image, the cloud-boot-image is also generated (to \
be written into the boot 'disk'). Ext4.gz images are generated, which can be \
uploaded as custom images in the Linode management portal."

IMAGE_FSTYPES = "ext4 ext4.gz"
EXTRA_IMAGECMD:ext4 = "-L rootfs-bundle"

MACHINEOVERRIDES =. "qemux86-64:"

KMACHINE:cloud-mutable-gadget = "qemux86-64"

INITRAMFS_IMAGE = "rauc-initramfs-image"
INITRAMFS_IMAGE_BUNDLE = "1"

MACHINE_ESSENTIAL_EXTRA_RRECOMMENDS:append = " \
    e2fsprogs-dumpe2fs \
    e2fsprogs-tune2fs \
    grub-editenv \
    rauc-label-handler \
"

RAUC_CONFIG_FILE = "${@bb.utils.which(d.getVar('BBPATH'), 'rauc/cloud.conf')}"

# For some reason, only one serial port works on these machines
SERIAL_CONSOLES = "115200;ttyS0"
```

## meta-gadget/conf/machine/qemu-mutable-gadget.conf
```bitbake
require conf/machine/qemux86-64.conf
require conf/machine/ab-mutable.conf

# Simple machine configuration for QEMU gadgets.
IMAGE_FSTYPES = "wic"
WKS_FILE = "qemu-mutable-gadget.wks"

MACHINEOVERRIDES =. "qemux86-64:"

KMACHINE:qemu-mutable-gadget = "qemux86-64"

INITRAMFS_IMAGE = "cloud-initramfs-image"
INITRAMFS_IMAGE_BUNDLE = "1"

EFI_PROVIDER = "grub-efi"
MACHINE_FEATURES += "efi"

MACHINE_ESSENTIAL_EXTRA_RRECOMMENDS:append = " \
    e2fsprogs-dumpe2fs \
    e2fsprogs-tune2fs \
    grub-editenv \
    cloud-label-handler \
"
# Use the RAUC configuration for the cloud-mutable-gadget. It doesn't matter
# because RAUC is never used for this device, in practice.
RAUC_CONFIG_FILE = "${@bb.utils.which(d.getVar('BBPATH'), 'rauc/cloud.conf')}"
```

## meta-gadget/conf/machine/rpi-ab-mutable-gadget.conf
```bitbake
require conf/machine/rpi-gadget.conf
require conf/machine/ab-mutable.conf

# The boot partition contains only the things it needs to on these gadgets.
MACHINE_FEATURES += "minimal-bootpart"

# For this gadget, install only the required boot files, U-boot, and the boot
# script into the bootimg-partition. U-boot can use the same device tree blob
# as the kernel.
IMAGE_BOOT_FILES = " \
    ${BOOTFILES_DIR_NAME}/* \
    u-boot.bin;${SDIMG_KERNELIMAGE} \
    bcm2711-rpi-4-b.dtb \
    boot.scr \
"

# Install kernel image and device tree into the rootfs (instead of the boot
# partition)
# TODO: Remove this when I'm ready to migrate mail.harmonyfoodsonline.com to the new boot scheme.
RDEPENDS:${KERNEL_PACKAGE_NAME}-base += "kernel-devicetree"

# The order of these matters. RAUC uses the first one as the image type to
# place in the bundle.
IMAGE_FSTYPES = "tar.bz2 wic.bz2 wic.bmap"
WKS_FILE = "ab-mutable-raspberrypi.wks"

# Add stuff needed for software update
MACHINE_ESSENTIAL_EXTRA_RRECOMMENDS:append = " \
    u-boot-fw-utils \
"

PREFERRED_PROVIDER_virtual/u-boot-env = "u-boot-env-ab-mutable"
IMAGE_BOOT_FILES += "uboot.env"

PREFERRED_PROVIDER_u-boot-default-script = "u-boot-rauc-boot"

RAUC_CONFIG_FILE = "${@bb.utils.which(d.getVar('BBPATH'), 'rauc/rpi.conf')}"
```

## meta-gadget/conf/machine/rpi-gadget.conf
```bitbake
require conf/machine/gadget.inc
require conf/machine/raspberrypi4-64.conf

PREFERRED_VERSION_linux-raspberrypi = "${GADGET_KERNEL_VERSION}"

# Enable U-boot
RPI_USE_U_BOOT = "1"

# Enable UART in config.txt
ENABLE_UART = "1"
```
