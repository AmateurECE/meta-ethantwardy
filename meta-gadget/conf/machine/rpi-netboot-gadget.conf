## meta-gadget/conf/machine/rpi-netboot-gadget.conf
```bitbake
require conf/machine/rpi-gadget.conf

MACHINEOVERRIDES =. "netboot:"

IMAGE_BOOT_FILES += "uboot.env"

# This image's WIC file only contains a boot partition
WKS_FILE = "bootloader-only-image.wks"

# Build a rootfs tarball and a wic image (containing just the bootloader)
IMAGE_FSTYPES = "tar.gz wic"

# Netboot gadgets need netboot-specific U-boot configuration
PREFERRED_PROVIDER_virtual/u-boot-env = "u-boot-env-netboot"
```

## meta-gadget/conf/machine/x86-64-mutable-gadget.conf
```bitbake
#@TYPE: Machine
#@NAME: x86-64 Mutable Gadget
#@DESCRIPTION: x86-64 Mutable Gadget

require conf/machine/gadget.inc
require conf/machine/ab-mutable.conf
require conf/machine/include/x86/tune-x86-64-v3.inc

PREFERRED_PROVIDER_virtual/kernel = "linux-yocto"
PREFERRED_VERSION_linux-yocto = "${GADGET_KERNEL_VERSION}"

KCONF_AUDIT_LEVEL = "2"
KERNEL_IMAGETYPE = "bzImage"

# Simple machine configuration for x86-64 gadgets.
IMAGE_FSTYPES += "wic.bz2 wic.bmap"
WKS_FILE = "x86-64-mutable-gadget.wks"

MACHINEOVERRIDES =. "qemux86-64:"
KMACHINE:x86-64-mutable-gadget = "common-pc-64"

MACHINE_FEATURES += "\
    acpi usb keyboard screen pci \
    ext4 vfat \
    "

EFI_PROVIDER = "grub-efi"
MACHINE_FEATURES += "efi"

MACHINE_ESSENTIAL_EXTRA_RRECOMMENDS:append = " \
    grub-editenv \
"

RAUC_CONFIG_FILE = "${@bb.utils.which(d.getVar('BBPATH'), 'rauc/x86-64.conf')}"
```

## meta-gadget/wic/ab-mutable-raspberrypi.wks
```
# short-description: Raspberry Pi Dual A/B image w/ mutable data partition

part /boot --source bootimg-partition --ondisk mmcblk0 --fstype=vfat --label boot --active --align 4096 --size 100
part / --source rootfs --ondisk mmcblk0 --fstype=ext4 --label root --align 4096
part --source rootfs --ondisk mmcblk0 --fstype=ext4 --label root --align 4096
part --ondisk mmcblk0 --fstype=btrfs --label gadget-data --align 1024 --size 1G
```

## meta-gadget/wic/bootloader-only-image.wks
```
# Create netboot capable image (contains only the boot partition)
part /boot --source bootimg-partition --ondisk mmcblk0 --fstype=vfat --label boot --active --align 4096 --size 100
```

## meta-gadget/wic/gadget.wks
```
part /boot --source bootimg-pcbios --ondisk sda --label boot --active --align 1024
part / --source rootfs --ondisk sda --fstype=ext4 --label platform --align 1024 --use-uuid
part /data --ondisk sda --size 256M --label data --fstype=ext4
bootloader --ptable gpt --timeout=0 --append="ro console=ttyS0"
```

## meta-gadget/wic/pcbios-gadget.wks
```
part /boot --source bootimg-pcbios --ondisk sda --label boot --active --align 1024
part / --source rootfs --ondisk sda --fstype=ext4 --label platform --align 1024 --use-uuid
bootloader --ptable gpt --timeout=0 --append="ro console=ttyS0"
```

## meta-gadget/wic/qemu-mutable-gadget.wks
```
part /boot --source bootimg-efi --sourceparams="loader=grub-efi" --fstype=vfat --label boot --active --align 1024
part / --source rootfs --fstype=ext4 --label system0 --align 1024 --use-uuid
bootloader --ptable=gpt --configfile="qemu-mutable-gadget-grub.cfg"
```

## meta-rock64-bsp/conf/layer.conf
```bitbake
# We have a conf and classes directory, add to BBPATH
BBPATH .= ":${LAYERDIR}"

BBFILES += "\
${LAYERDIR}/recipes*/*/*.bb \
${LAYERDIR}/recipes*/**/*.bbappend \
"

BBFILE_COLLECTIONS += "edtwardy"
BBFILE_PATTERN_edtwardy = "^${LAYERDIR}/"
BBFILE_PRIORITY_edtwardy = "6"

LAYERDEPENDS_edtwardy = "core"
LAYERSERIES_COMPAT_edtwardy = "dunfell hardknott"
```

## meta-rpi-bsp/conf/distro/poky-player.conf
```bitbake
DISTRO_NAME = "poky-player"
DISTRO_VERSION = "1"

DISTRO_FEATURES:append = " agl-devel systemd"
DISTRO_FEATURES_BACKFILL_CONSIDERED += "sysvinit"
VIRTUAL-RUNTIME_init_manager = "systemd"
VIRTUAL-RUNTIME_initscripts = "systemd-compat-units"

require conf/distro/poky.conf

PACKAGECONFIG:append:pn-dbus = " verbose-mode"
```

## meta-rpi-bsp/conf/layer.conf
```bitbake
# We have a conf and classes directory, add to BBPATH
BBPATH .= ":${LAYERDIR}"

BBFILES += "\
${LAYERDIR}/recipes*/*/*.bb \
${LAYERDIR}/recipes*/**/*.bbappend \
"

BBFILE_COLLECTIONS += "rpi-bsp"
BBFILE_PATTERN_rpi-bsp = "^${LAYERDIR}/"
BBFILE_PRIORITY_rpi-bsp = "6"

LAYERDEPENDS_rpi-bsp = "core raspberrypi"
LAYERSERIES_COMPAT_rpi-bsp = "scarthgap"
```

## meta-rpi-gadget/conf/layer.conf
```bitbake
# We have a conf and classes directory, add to BBPATH
BBPATH .= ":${LAYERDIR}"

# We have recipes-* directories, add to BBFILES
BBFILES += "${LAYERDIR}/recipes-*/*/*.bb \
            ${LAYERDIR}/recipes-*/*/*.bbappend"

BBFILE_COLLECTIONS += "rpi-gadget"
BBFILE_PATTERN_rpi-gadget = "^${LAYERDIR}/"
BBFILE_PRIORITY_rpi-gadget = "6"

LAYERDEPENDS_rpi-gadget = "core gadget"
LAYERSERIES_COMPAT_rpi-gadget = "scarthgap styhead"
```

## meta-rpi-gadget/conf/machine/rpi-ab-mutable-gadget.conf
```bitbake
require conf/machine/rpi-gadget.conf

MACHINEOVERRIDES =. "ab-mutable:"

# The boot partition contains only the things it needs to on these gadgets.
MACHINE_FEATURES += "minimal-bootpart"

# For this gadget, install only the required boot files, U-boot, and the boot
# script into the bootimg-partition.
IMAGE_BOOT_FILES = " \
    ${BOOTFILES_DIR_NAME}/* \
    u-boot.bin;${SDIMG_KERNELIMAGE} \
    boot.scr \
"

# Install kernel image and device tree into the rootfs (instead of the boot
# partition)
RDEPENDS:${KERNEL_PACKAGE_NAME}-base += "kernel-image kernel-devicetree"

IMAGE_FSTYPES = "wic.bz2 wic.bmap tar.bz2"
WKS_FILE ?= "ab-mutable-raspberrypi.wks"

# Add stuff needed for software update
MACHINE_ESSENTIAL_EXTRA_RRECOMMENDS:append = " \
    rauc \
    u-boot-fw-utils \
    e2fsprogs \
    kernel-module-dm-verity \
"
```

## meta-rpi-gadget/conf/machine/rpi-gadget.conf
```bitbake
require conf/machine/raspberrypi4-64.conf

# Enable U-boot
RPI_USE_U_BOOT = "1"

# Enable UART in config.txt
ENABLE_UART = "1"
```

## meta-rpi-gadget/conf/machine/rpi-netboot-gadget.conf
```bitbake
require conf/machine/rpi-gadget.conf

MACHINEOVERRIDES =. "netboot:"

IMAGE_BOOT_FILES += "uboot.env"
```

## meta-stereo-gadget/conf/distro/stereo-gadget.conf
```bitbake
DISTRO = "stereo-gadget"
DISTRO_NAME = "stereo-gadget"
DISTRO_VERSION = "1"

LICENSE_FLAGS_ACCEPTED = "synaptics-killswitch"

DISTRO_FEATURES = "\
usrmerge systemd \
ipv4 ipv6 wifi \
alsa \
usbhost \
bluetooth \
"

# Disables these distro features since we don't require them. See:
# https://docs.yoctoproject.org/5.0.5/singleindex.html#feature-backfilling
DISTRO_FEATURES_BACKFILL_CONSIDERED = "sysvinit gobject-introspection-data"

VIRTUAL-RUNTIME_init_manager = "systemd"
VIRTUAL-RUNTIME_initscripts = "systemd-compat-units"

# Minimize pipewire configuration. Avahi configuration would be required if we
# ever wanted to support Airplay reception.
PACKAGECONFIG:remove:pn-pipewire = " \
systemd-user-service \
flatpak \
pulseaudio jack gstreamer raop \
v4l2 libcamera webrtc-echo-cancelling \
gsettings avahi \
"

# Minimize bluez5 configuration.
PACKAGECONFIG:remove:pn-bluez5 = " \
obex-profiles \
network-profiles \
hid-profiles \
hog-profiles \
"

# RPi 4 bluetooth depends on hciattach to start up the Bluetooth modem, which
# is only built with --enable-tools and --enable-deprecated.
PACKAGECONFIG:append:pn-bluez5 = " tools"

PACKAGECONFIG:remove:pn-wireplumber = " systemd-user-service"

VIRTUAL-RUNTIME_wireplumber-config = "stereo-gadget-wp-config"
```

## meta-stereo-gadget/conf/layer.conf
```bitbake
# We have a conf and classes directory, add to BBPATH
BBPATH .= ":${LAYERDIR}"

BBFILES += "\
${LAYERDIR}/recipes*/*/*.bb \
${LAYERDIR}/recipes*/**/*.bbappend \
"

BBFILE_COLLECTIONS += "stereo-gadget"
BBFILE_PATTERN_stereo-gadget = "^${LAYERDIR}/"
BBFILE_PRIORITY_stereo-gadget = "99"

LAYERDEPENDS_stereo-gadget = "core raspberrypi"
LAYERSERIES_COMPAT_stereo-gadget = "scarthgap"
```

## meta-stereo-gadget/conf/machine/stereo-gadget.conf
```bitbake
require conf/machine/raspberrypi4-64.conf

# Disable this machine feature to save build time. See "Feature backfilling"
# in the Yocto user manual.
MACHINE_FEATURES_BACKFILL_CONSIDERED = "qemu-usermode"

# Enable U-boot
RPI_USE_U_BOOT = "1"

# Enable UART in config.txt
ENABLE_UART = "1"
```
